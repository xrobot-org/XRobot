#include "bsp_oled.h"
#include "main.h"
#include "spi.h"

#define OLED_CMD_Set()	HAL_GPIO_WritePin(OLED_DC_GPIO_Port, OLED_DC_Pin, GPIO_PIN_SET)
#define OLED_CMD_Clr()	HAL_GPIO_WritePin(OLED_DC_GPIO_Port, OLED_DC_Pin, GPIO_PIN_RESET)

#define OLED_RST_Set()	HAL_GPIO_WritePin(OLED_RST_GPIO_Port, OLED_RST_Pin, GPIO_PIN_SET)
#define OLED_RST_Clr()	HAL_GPIO_WritePin(OLED_RST_GPIO_Port, OLED_RST_Pin, GPIO_PIN_RESET)

typedef enum {
	OLED_WriteCMD = 0,
	OLED_WriteData = 1,
}OLED_WriteTypedef;

typedef struct {
	uint8_t column;
	uint8_t page;
}OLED_CursorTtpedef;

const uint8_t oled_font[95][8] = {
	{0x00,0x00,0x00,0x00,0x00,0x00,0x00,0x00,}, /* " ", 0 */
	{0x00,0x00,0x00,0xcf,0xcf,0x00,0x00,0x00,}, /* "!", 1 */
	{0x00,0x0c,0x06,0x00,0x0c,0x06,0x00,0x00,}, /* """, 2 */
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	{0x00,0x08,0x04,0x04,0x08,0x10,0x10,0x08,}, /* "~", 94 */
};

static uint8_t oled_gram[8][128] = {
	{
	0x00,0x00,0x00,0x00,0x00,0x00,0x00,0x00,0x00,0x00,0x00,0xcf,0xcf,0x00,0x00,
	0x00,0x0c,0x06,0x00,0x0c,0x06,0x00,0x00,0x24,0xe4,0x3c,0x27,0xe4,0x3c,0x27,
	0x00,0x20,0x46,0xf9,0x9f,0x62,0x04,0x00,0x06,0x09,0xc6,0x30,0x0c,0x63,0x90,
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	0x00,0x00,0x00,0x00,0xc0,0xc0,0x00,0x00,0x00,0x00,0x00,0xc0,0x38,0x07,0x00,},
	{
	0x00,0x00,0x7c,0x92,0x8a,0x7c,0x00,0x00,0x00,0x00,0x00,0x84,0xfe,0x80,0x00,
	0x00,0x00,0x8c,0xc2,0xa2,0x9c,0x00,0x00,0x00,0x00,0x44,0x92,0x92,0x6c,0x00,
	0x00,0x20,0x38,0x24,0xfe,0x20,0x00,0x00,0x00,0x00,0x5e,0x92,0x92,0x62,0x00,
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	0x00,0x00,0x00,0x44,0x28,0x10,0x00,0x00,0x00,0x00,0x0c,0xa2,0x92,0x1c,0x00,},
	{
	0x00,0x3c,0x42,0x99,0xa5,0xa2,0x3c,0x00,0x00,0xe0,0x1c,0x12,0x12,0x1c,0xe0,
	0x00,0xfe,0x92,0x92,0x9c,0x90,0x60,0x00,0x00,0x38,0x44,0x82,0x82,0x82,0x44,
	0x00,0xfe,0x82,0x82,0x82,0x82,0x7c,0x00,0x00,0xfe,0x92,0x92,0x92,0x92,0x92,
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	0x00,0xfe,0x04,0x18,0x30,0x40,0xfe,0x00,0x00,0x7c,0x82,0x82,0x82,0x82,0x7c,},
	{
	0x00,0x00,0xfe,0x12,0x12,0x0c,0x00,0x00,0x00,0x00,0x3c,0x42,0xc2,0xbc,0x00,
	0x00,0x00,0xfe,0x32,0x52,0x8c,0x00,0x00,0x00,0x00,0x4c,0x92,0x92,0x64,0x00,
	0x00,0x02,0x02,0xfe,0x02,0x02,0x00,0x00,0x00,0x7e,0x80,0x80,0x80,0x80,0x7e,
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	0x00,0x30,0x0c,0x02,0x0c,0x30,0x00,0x00,0x00,0x80,0x80,0x80,0x80,0x80,0x80,},
	{
	0x00,0x00,0x04,0x0c,0x18,0x00,0x00,0x00,0x00,0x00,0x60,0x90,0x90,0xe0,0x00,
	0x00,0x00,0xf8,0xa0,0xe0,0x00,0x00,0x00,0x00,0x00,0x60,0x90,0x90,0x00,0x00,
	0x00,0x00,0xe0,0xa0,0xf8,0x00,0x00,0x00,0x00,0x00,0x70,0xa8,0xa8,0x90,0x00,
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	0x00,0x00,0xf0,0x10,0x10,0xe0,0x00,0x00,0x00,0x00,0x60,0x90,0x90,0x60,0x00,},
	{
	0x00,0x00,0xf0,0x48,0x48,0x30,0x00,0x00,0x00,0x00,0x30,0x48,0x48,0xf0,0x00,
	0x00,0x00,0x00,0xf0,0x20,0x10,0x00,0x00,0x00,0x00,0x90,0xa8,0xa8,0x48,0x00,
	0x00,0x10,0x10,0xf8,0x90,0x90,0x00,0x00,0x00,0x00,0x78,0x80,0x80,0xf8,0x00,
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	0x00,0x08,0x04,0x04,0x08,0x10,0x10,0x08,}
};

OLED_CursorTtpedef oled_cursor = {0};

static volatile bool modified = true;

static void OLED_WriteByte(uint8_t data, OLED_WriteTypedef type) {
	switch(type) {
		case OLED_WriteCMD:
			OLED_CMD_Clr();
		break;
		
		case OLED_WriteData:
			OLED_CMD_Set();
		break;
	}
	HAL_SPI_Transmit(&hspi1, &data, 1, 10);
}

BSP_StatusTypedef OLED_DisplayOn(void) {
	OLED_WriteByte(0x8d, OLED_WriteCMD);
	OLED_WriteByte(0x14, OLED_WriteCMD);
	OLED_WriteByte(0xaf, OLED_WriteCMD);
	return BSP_OK;
}

BSP_StatusTypedef OLED_DisplayOff(void) {
	OLED_WriteByte(0x8d, OLED_WriteCMD);
	OLED_WriteByte(0x10, OLED_WriteCMD);
	OLED_WriteByte(0xae, OLED_WriteCMD);
	return BSP_OK;
}

BSP_StatusTypedef OLED_Refresh(void) {
	if (modified) {
		for (uint8_t i = 0; i < 8; i++)	{
			OLED_WriteByte((0xb0 + i), OLED_WriteCMD); /* Set page address y. */
			OLED_WriteByte((2 & 0x0f), OLED_WriteCMD); /* Set column low address. */
			OLED_WriteByte(((2 >> 4) + 0x10), OLED_WriteCMD); /* Set column high address. */
			for (uint8_t n = 0; n < 128; n++) {
				OLED_WriteByte(oled_gram[i][n], OLED_WriteData);
			}
		}
		modified = false;
	}
	
	return BSP_OK;
}

BSP_StatusTypedef OLED_SetAll(OLED_PenTypedef pen) {
	switch(pen) {
		case OLED_PEN_WRITE:
			memset(oled_gram, -1, sizeof(oled_gram));
		break;
		
		case OLED_PEN_CLEAR:
			memset(oled_gram, 0, sizeof(oled_gram));
		break;
				
		case OLED_PEN_INVERSION:
			for (uint8_t i = 0; i < 8; i++) {
				for (uint8_t n = 0; n < 128; n++) {
					oled_gram[n][i] = ~oled_gram[n][i];
				}
			}
		break;
	}
	return BSP_OK;
}

BSP_StatusTypedef OLED_Init(void) {
	OLED_RST_Clr();
	HAL_Delay(500);
	OLED_RST_Set();
	
	OLED_WriteByte(0xae, OLED_WriteCMD);	/* Dot martix display off. */
	OLED_WriteByte(0x32, OLED_WriteCMD);	/* Set pump voltage 8v. */
	OLED_WriteByte(0x40, OLED_WriteCMD);	/* Set display start line. */
	OLED_WriteByte(0x81, OLED_WriteCMD);	/* Contarst control. */
	OLED_WriteByte(0xcf, OLED_WriteCMD);
	OLED_WriteByte(0xa1, OLED_WriteCMD);	/* Set segment re-map. */
	OLED_WriteByte(0xa4, OLED_WriteCMD);	/* Entire display off. */
	OLED_WriteByte(0xa6, OLED_WriteCMD);	/* Set normal display. */
	OLED_WriteByte(0xa8, OLED_WriteCMD);	/* Set multiples ration. */
	OLED_WriteByte(0x3f, OLED_WriteCMD);
	OLED_WriteByte(0xad, OLED_WriteCMD);	/* Set DC/DC booster. */
	OLED_WriteByte(0x8b, OLED_WriteCMD);
	OLED_WriteByte(0xc8, OLED_WriteCMD);	/* Com scan COM0-COM63. */
	OLED_WriteByte(0xd3, OLED_WriteCMD);	/* Set display offset. */
	OLED_WriteByte(0x00, OLED_WriteCMD);
	OLED_WriteByte(0xd5, OLED_WriteCMD);	/* Set frame frequency. */
	OLED_WriteByte(0x80, OLED_WriteCMD);
	OLED_WriteByte(0xd9, OLED_WriteCMD);	/* Set pre_charge period. */
	OLED_WriteByte(0x1f, OLED_WriteCMD);
	OLED_WriteByte(0xda, OLED_WriteCMD);	/* Com pin configuration. */
	OLED_WriteByte(0x12, OLED_WriteCMD);
	OLED_WriteByte(0xdb, OLED_WriteCMD);	/* Set vcom deselect level. */
	OLED_WriteByte(0x40, OLED_WriteCMD);
	OLED_WriteByte(0xaf, OLED_WriteCMD);	/* Display on. */

	OLED_Refresh(); /* Display initial picture. */
	OLED_SetAll(OLED_PEN_CLEAR);  /* Clear memory. */
	return BSP_OK;
}

BSP_StatusTypedef OLED_Print(const char *str) {
	modified = true;
	
	for(uint16_t i = 0; str[i] != '\0'; i++) {
		uint8_t c = str[i];
		if (c < 32) {
			switch (c) {
				case '\n':
					oled_cursor.page ++;
					oled_cursor.column = 0;
				break;
				
				case '\t':
					oled_cursor.column += 16;
				break;
			}
		} else if (c < 126) {
			if (oled_cursor.column == 128) {
				oled_cursor.page ++;
				oled_cursor.column = 0;
			}
			if (oled_cursor.page == 8) {
				OLED_SetAll(OLED_PEN_CLEAR);
				oled_cursor.page = 0;
			}
			memcpy(&oled_gram[oled_cursor.page][oled_cursor.column], oled_font[c- 32], sizeof(oled_font[0]));
			oled_cursor.column += 8;
		}
	}
	return BSP_OK;
}

BSP_StatusTypedef OLED_Rewind(void) {
	OLED_SetAll(OLED_PEN_CLEAR);
	
	oled_cursor.page = 0;
	oled_cursor.column = 0;
	return BSP_OK;
}
