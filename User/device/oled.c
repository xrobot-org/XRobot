/* 
	OLED显示模块。
	
	使用SPI通信时，需要#define OLED_USE_SPI
	使用I2C通信时，需要#define OLED_USE_I2C

*/

/* Includes ------------------------------------------------------------------*/
/* Include 自身的头文件。*/
#include "oled.h"

/* Include 标准库。*/
#include <stdint.h>
#include <stdbool.h>
#include <string.h>

/* Include HAL相关的头文件。*/
#include "bsp_delay.h"
#include "bsp_spi.h"
#include <gpio.h>

#ifdef OLED_USE_SPI
#include "spi.h"
#

#elif defined OLED_USE_I2C
#include "i2c.h"

#endif


/* Include Component相关的头文件 */
/* Private define ------------------------------------------------------------*/
/* Private macro -------------------------------------------------------------*/
#ifdef OLED_USE_SPI

#define OLED_CMD_Set()	HAL_GPIO_WritePin(OLED_DC_GPIO_Port, OLED_DC_Pin, GPIO_PIN_SET)
#define OLED_CMD_Clr()	HAL_GPIO_WritePin(OLED_DC_GPIO_Port, OLED_DC_Pin, GPIO_PIN_RESET)

#define OLED_RST_Set()	HAL_GPIO_WritePin(OLED_RST_GPIO_Port, OLED_RST_Pin, GPIO_PIN_SET)
#define OLED_RST_Clr()	HAL_GPIO_WritePin(OLED_RST_GPIO_Port, OLED_RST_Pin, GPIO_PIN_RESET)

#elif defined OLED_USE_I2C
#define OLED_I2C_HANDLE hi2c1

#endif

/* Private typedef -----------------------------------------------------------*/
typedef enum {
	OLED_WriteCMD = 0,
	OLED_WriteData = 1,
}OLED_Write_t;


/* Private variables ---------------------------------------------------------*/
static const uint8_t oled_font[95][8] = {
	{0x00,0x00,0x00,0x00,0x00,0x00,0x00,0x00,}, /* " ", 0 */
	{0x00,0x00,0x00,0xcf,0xcf,0x00,0x00,0x00,}, /* "!", 1 */
	{0x00,0x0c,0x06,0x00,0x0c,0x06,0x00,0x00,}, /* """, 2 */
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	{0x00,0x08,0x04,0x04,0x08,0x10,0x10,0x08,}, /* "~", 94 */
};

static const uint8_t gram_logo[8][128] = {
	0x00,0x00,0x00,0x00,0x00,0x00,0x00,0x00,0x00,0x00,0x00,0x00,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0x00,
	0x00,0x00,0x00,0x00,0x00,0x00,0x00,0x00,0x00,0x00,0x00,0x00,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0x00,
	0x00,0x00,0x00,0x00,0x00,0x00,0x00,0x00,0x00,0x00,0x00,0x00,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0x00,
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	0x00,0x00,0x00,0x00,0x00,0x00,0x00,0x00,0x60,0x78,0x7B,0x1B,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0x00,
};

static OLED_t *goled;
static bool inited = false;

/* Private function -----------------------------------------------*/
static void OLED_WriteByte(uint8_t data, OLED_Write_t type) {
	
#ifdef OLED_USE_SPI
	switch(type) {
		case OLED_WriteCMD:
			OLED_CMD_Clr();
		break;
		
		case OLED_WriteData:
			OLED_CMD_Set();
		break;
	}
	BSP_SPI_Transmit(BSP_SPI_OLED, &data, 1);
	
#elif defined OLED_USE_I2C
	uint8_t cmd_data[2];
	
	switch(type) {
		case OLED_WriteCMD:
			cmd_data[0] = 0x00;
		break;
		
		case OLED_WriteData:
			cmd_data[0] = 0x40;
		break;
	}
	cmd_data[1] = data;
	HAL_I2C_Master_Transmit_DMA(OLED_I2C, OLED_I2C_ADDRESS, cmd_data, 2);
#endif
	
	BSP_Delay(1);
}

static void OLED_WriteSequenceData(uint8_t *data, uint16_t len) {
#ifdef OLED_USE_SPI
	OLED_CMD_Set();
	HAL_SPI_Transmit_DMA(&hspi1, data, len);
	
#elif defined OLED_USE_I2C
// TODO
	uint8_t cmd_data[2];
	cmd_data[0] = 0x40;
	cmd_data[1] = data;
	HAL_I2C_Master_Transmit_DMA(OLED_I2C, OLED_I2C_ADDRESS, cmd_data, 2);
#endif
}

/* Exported functions --------------------------------------------------------*/
int OLED_Init(OLED_t *oled) {
	if (oled == NULL)
		return -1;

	if (inited)
		return -1;
	
	oled->cursor.column = 0;
	oled->cursor.page = 0;
	oled->modified = true;
	
	goled = oled;
	
	OLED_RST_Clr();
	BSP_Delay(1);
	OLED_RST_Set();
	BSP_Delay(5);
	
	OLED_WriteByte(0xae, OLED_WriteCMD);	/* Dot martix display off. */
	OLED_WriteByte(0x00, OLED_WriteCMD);	/* Set lower column address:(00H~0FH). */
	OLED_WriteByte(0x10, OLED_WriteCMD);	/* Set higher column address:(10H~1FH). */
	OLED_WriteByte(0x20, OLED_WriteCMD);	/* Set Memory Addressing Mode */
	OLED_WriteByte(0x10, OLED_WriteCMD);	/* 00,Horizontal Addressing Mode;01,Vertical Addressing Mode;10,Page Addressing Mode (RESET);11,Invalid */
	OLED_WriteByte(0x32, OLED_WriteCMD);	/* Set pump voltage 8v. */
	OLED_WriteByte(0x40, OLED_WriteCMD);	/* Set display start line:(40H~7FH). */
	OLED_WriteByte(0x81, OLED_WriteCMD);	/* Contarst control. */
	OLED_WriteByte(0x6f, OLED_WriteCMD);	/* 		Contarst: 0x00~0xff. */
	OLED_WriteByte(0xa1, OLED_WriteCMD);	/* Set segment re-map. 0xa0 or 0xa1. */
	OLED_WriteByte(0xa4, OLED_WriteCMD);	/* Entire display off. */
	OLED_WriteByte(0xa6, OLED_WriteCMD);	/* Set normal display. */
	OLED_WriteByte(0xa8, OLED_WriteCMD);	/* Set multiplex ratio. */
	OLED_WriteByte(0x3f, OLED_WriteCMD);
	OLED_WriteByte(0xad, OLED_WriteCMD);	/* Set DC/DC booster. */
	OLED_WriteByte(0x8b, OLED_WriteCMD);
	OLED_WriteByte(0xb0, OLED_WriteCMD);	/* Set page address. */
	OLED_WriteByte(0xc8, OLED_WriteCMD);	/* Com scan COM0->COM63. */
	OLED_WriteByte(0xd3, OLED_WriteCMD);	/* Set display offset. */
	OLED_WriteByte(0x00, OLED_WriteCMD);
	OLED_WriteByte(0xd5, OLED_WriteCMD);	/* Set frame frequency. */
	OLED_WriteByte(0xf0, OLED_WriteCMD);
	OLED_WriteByte(0xd9, OLED_WriteCMD);	/* Set pre_charge period. */
	OLED_WriteByte(0x22, OLED_WriteCMD);
	OLED_WriteByte(0xda, OLED_WriteCMD);	/* Com pin configuration. */
	OLED_WriteByte(0x12, OLED_WriteCMD);
	OLED_WriteByte(0xdb, OLED_WriteCMD);	/* Set vcom deselect level. */
	OLED_WriteByte(0x20, OLED_WriteCMD);
	OLED_WriteByte(0x8d, OLED_WriteCMD);	/* Set DC-DC enable */
	OLED_WriteByte(0x14, OLED_WriteCMD);
	OLED_WriteByte(0xaf, OLED_WriteCMD);	/* Display on. */
	
	memcmp(oled->gram, gram_logo, sizeof(oled->gram));
	
	OLED_SetAllRam(oled, OLED_PEN_WRITE);  /* Clear memory. */
	
	OLED_Refresh(oled); /* Display initial picture. */
	return 0;
}

OLED_t *OLED_GetDevice(void) {
	if (inited) {
		return goled;
	}
	return NULL;
}

int OLED_PrintRam(OLED_t *oled, const char* str) {
	if (str == NULL)
		return -1;
	
	oled->modified = true;
	
	for(uint16_t i = 0; str[i] != '\0'; i++) {
		uint8_t c = str[i];
		if (c < 32) {
			switch (c) {
				case '\n':
					oled->cursor.page ++;
					oled->cursor.column = 0;
				break;
				
				case '\t':
					oled->cursor.column += 16;
				break;
			}
		} else if (c < 126) {
			if (oled->cursor.column == 128) {
				oled->cursor.page ++;
				oled->cursor.column = 0;
			}
			if (oled->cursor.page == 8) {
				OLED_SetAllRam(oled, OLED_PEN_CLEAR);
				oled->cursor.page = 0;
			}
			memcpy(&oled->gram[oled->cursor.page][oled->cursor.column], oled_font[c- 32], sizeof(oled_font[0]));
			oled->cursor.column += 8;
		}
	}
	return 0;
}

int OLED_RewindRam(OLED_t *oled) {
	oled->modified = true;

	OLED_SetAllRam(oled, OLED_PEN_CLEAR);
	
	oled->cursor.page = 0;
	oled->cursor.column = 0;
	return 0;
}

int OLED_SetAllRam(OLED_t *oled, OLED_Pen_t pen) {
	switch(pen) {
		case OLED_PEN_WRITE:
			memset(oled->gram, -1, sizeof(oled->gram));
		break;
		
		case OLED_PEN_CLEAR:
			memset(oled->gram, 0, sizeof(oled->gram));
		break;
				
		case OLED_PEN_INVERSION:
			for (uint8_t i = 0; i < 8; i++) {
				for (uint8_t n = 0; n < 128; n++) {
					oled->gram[i][n] = ~oled->gram[i][n];
				}
			}
		break;
	}
	return 0;
}

int OLED_DisplayOn(OLED_t *oled) {
	OLED_WriteByte(0x8d, OLED_WriteCMD);
	OLED_WriteByte(0x14, OLED_WriteCMD);
	OLED_WriteByte(0xaf, OLED_WriteCMD);
	return 0;
}

int OLED_DisplayOff(OLED_t *oled) {
	OLED_WriteByte(0x8d, OLED_WriteCMD);
	OLED_WriteByte(0x10, OLED_WriteCMD);
	OLED_WriteByte(0xae, OLED_WriteCMD);
	return 0;
}


void OLED_SetCursor(uint8_t x, uint8_t y)
{	
	OLED_WriteByte((0xb0 + y), OLED_WriteCMD);			  //set page address y
	OLED_WriteByte(((x&0xf0)>>4)|0x10, OLED_WriteCMD);	  //set column high address
	OLED_WriteByte((x&0x0f), OLED_WriteCMD);				//set column low address
}

int OLED_Refresh(OLED_t *oled) {
	for (uint8_t i = 0; i < 8; i++) {
		OLED_SetCursor(0, i);
		for (uint8_t n = 0; n < 8; n++) {
			OLED_WriteByte(oled->gram[i][n], OLED_WriteData);
		}
	}
	oled->modified = false;
	
	return 0;
}
