## src/robot/Kconfig
```kconfig
choice
    prompt "机器人型号"
    default RB_WHELL_LEG

    config RB_WHELL_LEG
        bool "轮腿平衡步兵"

    config RB_BALANCE
        bool "无腿平衡步兵"

    config RB_INFANTRY
        bool "麦轮步兵"

    config RB_SENTRY
        bool "哨兵"

    config RB_HERO
        bool "麦轮英雄"

    config RB_ENGINEER
        bool "麦轮工程"

    config RB_DART
        bool "飞镖"

    config RB_RADAR
        bool "雷达"
endchoice
```

## src/system/FreeRTOS/Kconfig
```kconfig
menu FreeRTOS

config INIT_TASK_STACK_DEPTH
    int "init任务堆栈大小"
    range 128 4096
    default 1024

config FREERTOS_TIMER_TASK_STACK_DEPTH
    int "软定时器任务堆栈大小"
    range 128 4096
    default 256

config FREERTOS_USB_TASK_STACK_DEPTH
    int "USB任务堆栈大小"
    range 128 4096
    default 256

config FREERTOS_TERM_TASK_STACK_DEPTH
    int "终端任务堆栈大小"
    range 128 4096
    default 512

endmenu
```

## src/system/Linux/Kconfig
```kconfig
menu Linux
config INIT_TASK_STACK_DEPTH
    int "init任务堆栈大小(Linux下不可用)"
    range 0 0
    default 0

config TERM_LOG_UDP_SERVER
    tristate "开启UDP服务器log打印"

config TERM_LOG_UDP_SERVER_PORT
    int "UDP服务器log打印端口" if TERM_LOG_UDP_SERVER
    range 0 65535
    default 1230
endmenu
```

## src/system/Linux_Webots/Kconfig
```kconfig
menu Linux
config INIT_TASK_STACK_DEPTH
    int "init任务堆栈大小(Linux下不可用)"
    range 0 0
    default 0
endmenu
```

## toolchain/Kconfig
```kconfig
menu "编译工具链"

choice
    prompt "工具链"
    default TC_ARM_NONE_EABI

    config TC_ARM_NONE_EABI
        bool "arm-none-eabi-" if BOARD_DEV_C

    config TC_ARM64_LINUX_GNUEABIHF
        bool "arm64-linux-gnueabihf" if BOARD_NX
endchoice

config TC_CLANG
	tristate "使用clang作为编译器" if TC_ARM_NONE_EABI

endmenu
```
