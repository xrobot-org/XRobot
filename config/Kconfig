## hw/Kconfig
```kconfig
menu "硬件平台"

source "../hw/bsp/Kconfig"

choice
    prompt "操作系统"
    default OS_FREERTOS

    config OS_FREERTOS
        bool "FreeRTOS" if BOARD_DEV_C

    config OS_Linux
        bool "Linux" if BOARD_NX

    config OS_CUSTOM
        bool "CUSTOM"
endchoice

endmenu
```

## hw/bsp/Kconfig
```kconfig
if BOARD_DEV_C
source "../hw/bsp/rm-c/Kconfig"
endif

choice
    prompt "开发板"
    default BOARD_DEV_C

    config BOARD_DEV_C
        bool "DEV_C-STM32F407IG"

    config BOARD_WEARLAB_NODE
        bool "WEARLAB_NODE-STM32F103C6"

    config BOARD_NX
        bool "NX-ARM64"

    config BOARD_CUSTOM
        bool "CUSTOM"
endchoice
```

## src/Kconfig
```kconfig
menu "比赛信息"

choice
    prompt "比赛类型"
    default GM_RMUC

    config GM_RMUC
        bool "超级对抗赛"

    config GM_RMUT
        bool "高校单项赛"

    config GM_RMUL
        bool "高校联盟赛"
endchoice

choice
    prompt "操作手"
    default PL_QS

    config PL_QS
        bool "曲燊"

    config PL_ZYMA
        bool "马志远"
endchoice

endmenu

source "../src/device/Kconfig"

source "../src/module/Kconfig"
```

## src/device/Kconfig
```kconfig
menu "调试选项"

config DEBUG_EN
	tristate "开启调试"

if DEBUG_EN

menu "机器人"

if ID_HERO || POWER_LIMIT_WITH_CAP || POWER_LIMIT
config DEBUG_POWER_UNLIMIT
	tristate "爆发吧 小宇宙！（不再限制功率）"
endif

endmenu

menu "裁判系统"

config REF_VIRTUAL
	tristate "预设参数覆盖裁判系统信息"

config REF_FORCE_ONLINE
	tristate "强制认为裁判系统在线" if REF_VIRTUAL

config REF_LAUNCH_SPEED
    int "射速限制" if REF_VIRTUAL
    range 5 30
    default 30

config REF_HEAT_LIMIT_17
    int "17mm枪口热量限制" if REF_VIRTUAL
    range 0 1000
    default 1000

config REF_HEAT_LIMIT_42
    int "42mm枪口热量限制" if REF_VIRTUAL
    range 0 1000
    default 1000

config REF_POWER_LIMIT
    int "底盘功率限制" if REF_VIRTUAL
    range 0 200
    default 1000

config REF_POWER_BUFF
    int "缓冲能量" if REF_VIRTUAL
    range 0 100
    default 100

endmenu

menu "上位机"

config HOST_CTRL_PRIORITY
	tristate "优先把控制权交给上位机"

config HOST_USB_DISABLE
    tristate "让出usb串口,开启命令行"

endmenu

endif

menu "遥控器"

choice
    prompt "左拨杆-下 功能"
    default LEVER_L_DEFAULT

    config LEVER_L_DEFAULT
        bool "默认"

    config LEVER_L_ROTATE
        bool "小陀螺" if DEBUG_EN
endchoice

choice
    prompt "右拨杆-下 功能"
    default LEVER_R_DEFAULT

    config LEVER_R_DEFAULT
        bool "默认"

    config LEVER_R_FIRE_SINLE
        bool "单发开火" if DEBUG_EN

    config LEVER_R_FIRE_BURST
        bool "爆发开火" if DEBUG_EN

    config LEVER_R_FIRE_CONT
        bool "持续开火" if DEBUG_EN
endchoice

endmenu

endmenu
```

## src/device/ahrs-9/Kconfig
```kconfig
config DEVICE_AHRS_TASK_STACK_DEPTH
    int "AHRS任务堆栈大小"
    range 128 4096
    default 256
```

## src/device/ai/Kconfig
```kconfig
menu "上位机"

    config HOST_CTRL_PRIORITY
        tristate "优先把控制权交给上位机"

endmenu
```

## src/device/aim/Kconfig
```kconfig
config DEVICE_AI_TASK_STACK_DEPTH

    int "AI任务堆栈大小"

    range 128 4096

    default 256

    menu "上位机"

    config HOST_CTRL_PRIORITY

        tristate "优先把控制权交给上位机"

    endmenu
```

## src/device/bmi088/Kconfig
```kconfig
config DEVICE_BMI088_TASK_STACK_DEPTH
    int "BMI088任务堆栈大小"
    range 128 4096
    default 256
```

## src/device/dr16/Kconfig
```kconfig
config DEVICE_DR16_TASK_STACK_DEPTH
    int "DR16任务堆栈大小"
    range 128 4096
    default 256
```

## src/device/icm42688/Kconfig
```kconfig
config DEVICE_ICM42688_TASK_STACK_DEPTH
    int "ICM42688任务堆栈大小"
    range 128 4096
    default 256
```

## src/device/laser/Kconfig
```kconfig
config DEVICE_LASER_TASK_STACK_DEPTH
    int "LASER任务堆栈大小"
    range 128 4096
    default 128
```

## src/device/led_rgb/Kconfig
```kconfig
config DEVICE_LED_RGB_TASK_STACK_DEPTH
    int "LED_RGB任务堆栈大小"
    range 128 4096
    default 128
```

## src/device/mmc5603/Kconfig
```kconfig
config DEVICE_MMC5603_TASK_STACK_DEPTH
    int "mmc5603任务堆栈大小"
    range 128 4096
    default 512
```

## src/device/referee/Kconfig
```kconfig
menu "裁判系统"

    config REF_VIRTUAL
        tristate "预设参数覆盖裁判系统信息"

    config REF_FORCE_ONLINE
        tristate "强制认为裁判系统在线" if REF_VIRTUAL

    config REF_LAUNCH_SPEED
        int "射速限制" if REF_VIRTUAL
        range 5 30
        default 30

    config REF_HEAT_LIMIT_17
        int "17mm枪口热量限制" if REF_VIRTUAL
        range 0 100
        default 100

    config REF_HEAT_LIMIT_42
        int "42mm枪口热量限制" if REF_VIRTUAL
        range 0 100
        default 100

    config REF_POWER_LIMIT
        int "底盘功率限制" if REF_VIRTUAL
        range 0 200
        default 1000

    config REF_POWER_BUFF
        int "缓冲能量" if REF_VIRTUAL
        range 0 100
        default 100

endmenu

menu "操作手UI"

config UI_DYNAMIC_CYCLE
    int "动态元素刷新周期"
    range 1 1000
    default 20

config UI_STATIC_CYCLE
    int "静态元素刷新周期"
    range 50 2000
    default 1000

endmenu
```

## src/device/simulator/Kconfig
```kconfig
menu "裁判系统"

    config REF_LAUNCH_SPEED
        int "射速限制"
        range 5 30
        default 30

    config REF_HEAT_LIMIT_17
        int "17mm枪口热量限制"
        range 0 100
        default 100

    config REF_HEAT_LIMIT_42
        int "42mm枪口热量限制"
        range 0 100
        default 100

    config REF_POWER_LIMIT
        int "底盘功率限制"
        range 0 200
        default 1000

    config REF_POWER_BUFF
        int "缓冲能量"
        range 0 100
        default 100

endmenu
```

## src/device/term/Kconfig
```kconfig
choice
    prompt "USB功能选择"
    default USB_CLI

    config USB_CLI
        bool "命令行" if DEBUG_EN

    config USB_REPORT
        bool "消息日志上报" if DEBUG_EN
endchoice
```

## src/module/Kconfig
```kconfig
menu "机器人参数"

choice
    prompt "功率限制"
    default POWER_LIMIT_WITH_CAP

    config POWER_LIMIT_WITH_CAP
        bool "有超级电容的功率限制" if RB_HERO || RB_INFANTRY

    config POWER_LIMIT
        bool "功率限制" if RB_SENTRY

    config POWER_UNLIMIT
        bool "功率无限制" if RB_ENGINEER || RB_DART || RB_RADAR
endchoice

if POWER_LIMIT_WITH_CAP

menu "超级电容"
config CAP_PERCENT_NO_LIM
    int "底盘不再限制功率的电容电量"
    range 0 100
    default 80

config CAP_PERCENT_WORK
    int "电容开始工作的电容电量"
    range 0 100
    default 30

config CAP_MAX_LOAD
    int "电容能够提供的最大功率"
    range 0 300
    default 100
endmenu

endif

if RB_SENTRY
menu "哨兵扫描参数"

config GIM_SCAN_ANGLE_BASE
    int "哨兵守家扫描角度"
    range 0 180
    default 80

config GIM_SCAN_YAW_SPEED
    int "哨兵YAW轴扫描速度"
    range 0 300
    default 80

config GIM_SCAN_PIT_SPEED
    int "哨兵PIT轴扫描速度"
    range 0 300
    default 80

config GIM_SCAN_CRITICAL_ERR
    int "哨兵变向临界值"
    range 0 20
    default 5

endmenu

endif

menu "操作手UI"

config UI_DYNAMIC_CYCLE
    int "动态元素刷新周期"
    range 1 1000
    default 20

config UI_STATIC_CYCLE
    int "静态元素刷新周期"
    range 50 2000
    default 1000

endmenu

endmenu
```

## src/module/balance/Kconfig
```kconfig
config MODULE_BALANCE_TASK_STACK_DEPTH
    int "BALANCE任务堆栈大小"
    range 128 4096
    default 384
```

## src/module/can_imu/Kconfig
```kconfig
config MODULE_CAN_IMU_TASK_STACK_DEPTH
    int "CAN_IMU任务堆栈大小"
    range 128 4096
    default 256

config IMU_USE_IN_WEARLAB
    tristate "For WearLab"
```

## src/module/chassis/Kconfig
```kconfig
config MODULE_CHASSIS_TASK_STACK_DEPTH
    int "CHASSIS任务堆栈大小"
    range 128 4096
    default 384
```

## src/module/gimbal/Kconfig
```kconfig
config MODULE_GIMBAL_TASK_STACK_DEPTH
    int "GIMBAL任务堆栈大小"
    range 128 4096
    default 512
```

## src/module/launcher/Kconfig
```kconfig
config MODULE_LAUNCHER_TASK_STACK_DEPTH
    int "LAUNCHER任务堆栈大小"
    range 128 4096
    default 384
```

## src/module/ore_collect/Kconfig
```kconfig
config MODULE_ORE_TASK_STACK_DEPTH
    int "ORE_COLLECT任务堆栈大小"
    range 128 4096
    default 384
```

## src/module/wheel_leg/Kconfig
```kconfig
config MODULE_WHEELLEG_TASK_STACK_DEPTH
    int "WHEELLEG任务堆栈大小"
    range 128 4096
    default 768
```
